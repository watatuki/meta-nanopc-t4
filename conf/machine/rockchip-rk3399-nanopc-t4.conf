## conf/machine/rockchip-rk3399-nanopc-t4.conf
```bitbake
# Copyright (c) 2019, Fuzhou Rockchip Electronics Co., Ltd
# Released under the MIT license (see COPYING.MIT for the terms)

#@TYPE: Machine
#@NAME: RK3399 Sapphire Excavator

require conf/machine/include/rk3399.inc

MALI_GPU = "midgard-t86x"
MALI_VERSION = "r14p0"

KERNEL_DEVICETREE = " \
    rockchip/rk3399-nanopi4-rev00.dtb \
    rockchip/rk3399-nanopi4-rev01.dtb \
    rockchip/rk3399-nanopi4-rev04.dtb \
    rockchip/rk3399-nanopi4-rev06.dtb \
    rockchip/rk3399-nanopi4-rev21.dtb \
"
KBUILD_DEFCONFIG = "nanopi4_linux_defconfig"
UBOOT_MACHINE = "rk3399_defconfig"
#UBOOT_MACHINE = "nanopi4_defconfig"

RK_WIFIBT_FIRMWARES = " \
	rkwifibt-firmware-ap6354-wifi \
	rkwifibt-firmware-ap6354-bt \
	brcm-tools \
"

MACHINE_EXTRA_RRECOMMENDS_append += " \
	linux-firmware-rk-cdndp \
"

#UBOOT_MAKE_TARGET ?= "u-boot-rockchip"
#PREFERRED_PROVIDER_virtual/bootloader = "u-boot-rockchip"
PREFERRED_PROVIDER_virtual/bootloader = "u-boot"
```
